/**
 * @cliArgs --board "/ti/boards/CC1352R1_LAUNCHXL" --product "simplelink_cc13x2_26x2_sdk@4.40.04.04"
 * @versions {"data":"2021010520","timestamp":"2021010520","tool":"1.7.0+1746","templates":null}
 */
const BOOSTXL_SHARP128 = scripting.addHardware("/ti/boards/boosterpacks/BOOSTXL-SHARP128");

/**
 * Import the modules used in this configuration.
 */
const Display  = scripting.addModule("/ti/display/Display", {}, false);
const Display1 = Display.addInstance();
const Display2 = Display.addInstance();
const GPIO     = scripting.addModule("/ti/drivers/GPIO");
const GPIO1    = GPIO.addInstance();
const RTOS     = scripting.addModule("/ti/drivers/RTOS");
const TRNG     = scripting.addModule("/ti/drivers/TRNG", {}, false);
const TRNG1    = TRNG.addInstance();

/**
 * Write custom configuration values to the imported modules.
 */
Display1.$hardware                   = BOOSTXL_SHARP128.components.LS013B7DH03;
Display1.$name                       = "CONFIG_Display_LCD";
Display1.lcdEnable.$name             = "CONFIG_GPIO_0";
Display1.lcdEnable.pinInstance.$name = "CONFIG_PIN_1";
Display1.lcdPower.$name              = "CONFIG_GPIO_1";
Display1.lcdPower.pinInstance.$name  = "CONFIG_PIN_2";
Display1.lcdSS.$name                 = "CONFIG_GPIO_2";
Display1.lcdSS.pinInstance.$name     = "CONFIG_PIN_3";

Display2.$name                    = "CONFIG_Display_UART";
Display2.$hardware                = system.deviceData.board.components.XDS110UART;
Display2.uart.$name               = "CONFIG_UART_0";
Display2.uart.txPinInstance.$name = "CONFIG_PIN_7";
Display2.uart.rxPinInstance.$name = "CONFIG_PIN_8";

GPIO1.$name             = "CONFIG_GPIO_LED_0";
GPIO1.$hardware         = system.deviceData.board.components.LED_GREEN;
GPIO1.pinInstance.$name = "CONFIG_PIN_0";

const CCFG              = scripting.addModule("/ti/devices/CCFG", {}, false);
CCFG.ccfgTemplate.$name = "ti_devices_CCFGTemplate0";

const SPI                  = scripting.addModule("/ti/drivers/SPI", {}, false);
const SPI1                 = SPI.addInstance({}, false);
SPI1.$name                 = "CONFIG_SPI_0";
Display1.spi               = SPI1;
SPI1.sclkPinInstance.$name = "CONFIG_PIN_4";
SPI1.misoPinInstance.$name = "CONFIG_PIN_5";
SPI1.mosiPinInstance.$name = "CONFIG_PIN_6";

TRNG1.$name = "CONFIG_TRNG_0";

/**
 * Pinmux solution for unlocked pins/peripherals. This ensures that minor changes to the automatic solver in a future
 * version of the tool will not impact the pinmux you originally saw.  These lines can be completely deleted in order to
 * re-solve from scratch.
 */
Display1.lcdEnable.gpioPin.$suggestSolution = "boosterpack.5";
Display1.lcdPower.gpioPin.$suggestSolution  = "boosterpack.2";
Display1.lcdSS.gpioPin.$suggestSolution     = "boosterpack.6";
Display2.uart.uart.$suggestSolution         = "UART0";
Display2.uart.uart.txPin.$suggestSolution   = "boosterpack.4";
Display2.uart.uart.rxPin.$suggestSolution   = "boosterpack.3";
GPIO1.gpioPin.$suggestSolution              = "boosterpack.40";
SPI1.spi.$suggestSolution                   = "SSI0";
SPI1.spi.sclkPin.$suggestSolution           = "boosterpack.7";
SPI1.spi.misoPin.$suggestSolution           = "boosterpack.14";
SPI1.spi.mosiPin.$suggestSolution           = "boosterpack.15";
SPI1.spi.dmaRxChannel.$suggestSolution      = "DMA_CH3";
SPI1.spi.dmaTxChannel.$suggestSolution      = "DMA_CH4";
